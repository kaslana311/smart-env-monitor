## board/Kconfig
```kconfig
menu "Hardware Drivers Config"

config SOC_STM32F407IG
    bool
    select SOC_SERIES_STM32F4
    select RT_USING_COMPONENTS_INIT
    select RT_USING_USER_MAIN
    default y

menu "Onboard Peripheral Drivers"

    menuconfig BSP_USING_CAN168M
        bool "Enable 168M can"
        select CAN168M_ENABLE_
        default y
    #配置监视器
    menuconfig CORE_USING_MONITOR
        bool "Enable software wdg"
        select CORE_USING_BUZZER
        select CORE_USING_RGB_LIGHT
        default n
        if CORE_USING_MONITOR
            config BSP_USING_WDT
                bool "Enable hardware wdg"
                select RT_USING_WDT
                default n
            config MONITOR_NEED_ALARM
                bool "Enable monitor alarm"
                default n
        endif

endmenu

menu "On-chip Peripheral Drivers"

    config BSP_USING_ON_CHIP_FLASH
        bool "Enable On-Chip Flash"
        default n
        
    config BSP_USING_GPIO
        bool "Enable GPIO"
        select RT_USING_PIN
        default y

    menuconfig BSP_USING_UART
        bool "Enable UART"
        default y
        select RT_USING_SERIAL
        if BSP_USING_UART
            config BSP_USING_UART1
                bool "Enable UART1"
                default y
            if BSP_USING_UART1
                config BSP_UART1_RX_USING_DMA
                    bool "Enable UART1 RX DMA"
                    depends on BSP_USING_UART1 && RT_SERIAL_USING_DMA
                    default n
                config BSP_UART1_TX_USING_DMA
                    bool "Enable UART1 TX DMA"
                    depends on BSP_USING_UART1 && RT_SERIAL_USING_DMA
                    default n
            endif

            config BSP_USING_UART3
                bool "Enable UART3"
                default y
            if BSP_USING_UART3
                config BSP_UART3_RX_USING_DMA
                    bool "Enable UART3 RX DMA"
                    depends on BSP_USING_UART3 && RT_SERIAL_USING_DMA
                    default n
                config BSP_UART3_TX_USING_DMA
                    bool "Enable UART3 TX DMA"
                    depends on BSP_USING_UART3 && RT_SERIAL_USING_DMA
                    default n
            endif

            config BSP_USING_UART6
                bool "Enable UART6"
                default y
            if BSP_USING_UART6
                config BSP_UART6_RX_USING_DMA
                    bool "Enable UART6 RX DMA"
                    depends on BSP_USING_UART6 && RT_SERIAL_USING_DMA
                    default n
                config BSP_UART6_TX_USING_DMA
                    bool "Enable UART6 TX DMA"
                    depends on BSP_USING_UART6 && RT_SERIAL_USING_DMA
                    default n
            endif
        endif

        
    menuconfig BSP_USING_PWM
        bool "Enable pwm"
        default n
        select RT_USING_PWM
        if BSP_USING_PWM

            menuconfig BSP_USING_PWM1
                bool "Enable timer1 output pwm"
                default y
                if BSP_USING_PWM1
                    config BSP_USING_PWM1_CH1
                        bool "Enable PWM1 channel1"
                endif

            menuconfig BSP_USING_PWM4
                bool "Enable timer4 output pwm"
                default n
                if BSP_USING_PWM4
                    config BSP_USING_PWM4_CH3
                        bool "Enable PWM4 channel3"
                endif

            menuconfig BSP_USING_PWM5
                bool "Enable timer5 output PWM"
                default n
                if BSP_USING_PWM5
                    config BSP_USING_PWM5_CH1
                        bool "Enable PWM5 channel1"
                        default n
                    config BSP_USING_PWM5_CH2
                        bool "Enable PWM5 channel2"
                        default n
                    config BSP_USING_PWM5_CH3
                        bool "Enable PWM5 channel3"
                        default n
                endif

            menuconfig BSP_USING_PWM10
                bool "Enable timer10 output PWM"
                default n
                if BSP_USING_PWM10
                    config BSP_USING_PWM10_CH1
                        bool "Enable PWM10 channel1"
                        default n
                endif

        endif
        
    menuconfig BSP_USING_CAN
        bool "Enable CAN"
        default n
        select RT_USING_CAN
        if BSP_USING_CAN
            config BSP_USING_CAN1
                bool "Enable CAN1"
                default n

            config BSP_USING_CAN2
                bool "Enable CAN2"
                default n

            config RT_CAN_USING_HDR
                bool "Enable CAN RX HDR"
                depends on BSP_USING_CAN &&(BSP_USING_CAN1||BSP_USING_CAN2)
                default n
        endif
        
    menuconfig BSP_USING_SPI
        bool "Enable SPI BUS"
        default n
        select RT_USING_SPI
        if BSP_USING_SPI
            config BSP_USING_SPI1
                bool "Enable SPI1 BUS"
                default n

            config BSP_SPI1_TX_USING_DMA
                bool "Enable SPI1 TX DMA"
                depends on BSP_USING_SPI1
                #select BSP_SPI1_TX_USING_DMA
                default n
                
            config BSP_SPI1_RX_USING_DMA
                bool "Enable SPI1 RX DMA"
                depends on BSP_USING_SPI1
                #select BSP_SPI1_RX_USING_DMA
                default n

            config BSP_USING_SPI2
                bool "Enable SPI2 BUS"
                default n

            config BSP_SPI2_TX_USING_DMA
                bool "Enable SPI2 TX DMA"
                depends on BSP_USING_SPI2
                #select BSP_SPI2_TX_USING_DMA
                default n
                
            config BSP_SPI2_RX_USING_DMA
                bool "Enable SPI2 RX DMA"
                depends on BSP_USING_SPI2
                #select BSP_SPI2_RX_USING_DMA
                default n
        endif

    menuconfig BSP_USING_I2C
        bool "Enable I2C"
        default n
        select RT_USING_I2C
        if BSP_USING_I2C
            config BSP_USING_I2C2
                bool "Enable I2C2"
                default n

            config BSP_I2C2_SCL_PIN
                int "i2c2 scl pin number"
                range 0 175
                default 81

            config BSP_I2C2_SDA_PIN
                int "i2c2 sda pin number"
                range 0 175
                default 80
        endif

    config BSP_USING_WDT
        bool "Enable Watchdog Timer"
        select RT_USING_WDT
        default n
    
    config BSP_USING_DSP
        bool "Enable STM32 DSP Libarary"
        default n
    source "../libraries/HAL_Drivers/Kconfig"    
    
endmenu

menu "Board extended module Drivers"

endmenu
 
endmenu
```
